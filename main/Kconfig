## main/Kconfig
```kconfig
menu "TODO App Configuration"

    config TODO_SERVER_URL
        string "Flask Server URL"
        default "http://192.168.1.100:5000"
        help
            Flask 后端服务器地址，例如: http://192.168.1.100:5000
            请修改为你的实际服务器 IP 地址

    config TODO_API_KEY
        string "API Key for authentication"
        default "esp32-todo-secret-key-2025"
        help
            用于与 Flask 后端通信的 API 密钥
            必须与后端配置保持一致

    config WIFI_SSID
        string "WiFi SSID"
        default "YourWiFiSSID"
        help
            WiFi 网络名称（SSID）

    config WIFI_PASSWORD
        string "WiFi Password"
        default "YourWiFiPassword"
        help
            WiFi 网络密码

endmenu
```

## sdkconfig.defaults
```kconfig
# PSRAM 配置
CONFIG_SPIRAM=y
CONFIG_SPIRAM_MODE_OCT=y
CONFIG_SPIRAM_SPEED_80M=y

# LVGL 配置
CONFIG_LV_USE_USER_DATA=y
CONFIG_LV_USE_CHART=y
# CONFIG_LV_USE_PERF_MONITOR is not set

# LVGL 字体配置
CONFIG_LV_FONT_MONTSERRAT_14=y
CONFIG_LV_FONT_MONTSERRAT_22=y

# Cache 配置
CONFIG_ESP32S3_DATA_CACHE_LINE_64B=y
CONFIG_ESP32S3_DATA_CACHE_LINE_SIZE=64

# FATFS 配置
CONFIG_FATFS_LFN_STACK=y
CONFIG_FATFS_MAX_LFN=255
CONFIG_FATFS_API_ENCODING_ANSI_OEM=y

# Flash 配置
CONFIG_ESPTOOLPY_FLASHSIZE_16MB=y
CONFIG_PARTITION_TABLE_CUSTOM=y

# CPU 频率
CONFIG_ESP_DEFAULT_CPU_FREQ_MHZ_240=y

# WiFi 功能已启用

# TODO App 配置（请根据实际情况修改）
# 注意：这些是默认值，首次编译后请运行 idf.py menuconfig 修改为你的实际配置
CONFIG_TODO_SERVER_URL="http://192.168.1.100:5000"
CONFIG_TODO_API_KEY="esp32-todo-secret-key-2025"
CONFIG_WIFI_SSID="YourWiFiSSID"
CONFIG_WIFI_PASSWORD="YourWiFiPassword"
```
